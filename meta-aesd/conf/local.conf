## meta-aesd/conf/local.conf
```bitbake
MACHINE = "qemuarm64"
# ...existing code...
CORE_IMAGE_EXTRA_INSTALL += " scull misc-modules"
INHERIT += "extrausers"
EXTRA_USERS_PARAMS = "usermod -P root root;"
```
